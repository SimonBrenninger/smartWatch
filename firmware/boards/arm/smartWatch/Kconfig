## firmware/boards/arm/smartWatch/Kconfig.board
```kconfig
#
# Copyright (c) 2023 Simon Brenninger
#
# SPDX-License-Identifier: GPLv3
#

config BOARD_SMARTWATCH
	bool "SmartWatch"
	depends on SOC_NRF52810_QFAA
```

## firmware/boards/arm/smartWatch/Kconfig.defconfig
```kconfig
#
# Copyright (c) 2023 Simon Brenninger
#
# SPDX-License-Identifier: GPLv3
#

if BOARD_SMARTWATCH

config BOARD
	default "smartWatch"

config BT_CTLR
	default BT

config HW_STACK_PROTECTION
	default ARCH_HAS_STACK_PROTECTION

endif # BOARD_SMARTWATCH
```

## firmware/boards/custom/smartWatch/Kconfig.smartWatch
```kconfig
# smartWatch board configuration

# Copyright (c) 2018 Nordic Semiconductor ASA
# SPDX-License-Identifier: Apache-2.0

config BOARD_SMARTWATCH
	select SOC_NRF52810_QFAA
```

## firmware/boards/custom/smartWatch/board.yml
```yaml
#
# Copyright (c) 2025 Simon Brenninger
# SPDX-License-Identifier: GPLv3
#

board:
  name: smartWatch
  vendor: custom
  socs:
  - name: nrf52810
```

## src/app/boards/arm/smartWatch/smartWatch_defconfig
```kconfig
#
# Copyright (c) 2023 Simon Brenninger
#
# SPDX-License-Identifier: GPLv3
#

CONFIG_SOC_SERIES_NRF52X=y
CONFIG_SOC_NRF52810_QFAA=y
CONFIG_BOARD_SMARTWATCH=y

# Enable MPU
CONFIG_ARM_MPU=y


# enable GPIO
CONFIG_GPIO=y

CONFIG_GPIO_AS_PINRESET=y

# enable uart driver
CONFIG_SERIAL=y

# enable console
CONFIG_CONSOLE=y
CONFIG_UART_CONSOLE=y

CONFIG_PINCTRL=y
```

## src/zephyr/boards/arm/feather_test/Kconfig.board
```kconfig
# nRF52 DK nRF52810 board configuration

# Copyright (c) 2018 Nordic Semiconductor ASA
# SPDX-License-Identifier: Apache-2.0

config BOARD_FEATHER_TEST
	bool "feather_test"
	depends on SOC_NRF52840_QIAA
```

## src/zephyr/boards/arm/feather_test/Kconfig.defconfig
```kconfig
# nRF52 DK nRF52810 board configuration

# Copyright (c) 2018 Nordic Semiconductor ASA
# SPDX-License-Identifier: Apache-2.0

if BOARD_FEATHER_TEST

config BOARD
	default "feather_test"

endif # BOARD_SMARTWATCH
```

## src/zephyr/boards/arm/smartWatch/Kconfig.board
```kconfig
#
# Copyright (c) 2019 Nordic Semiconductor
#
# SPDX-License-Identifier: LicenseRef-Nordic-5-Clause
#

config BOARD_SMARTWATCH
	bool "SmartWatch"
	depends on SOC_NRF52810_QFAA
```

## src/zephyr/boards/arm/smartWatch/Kconfig.defconfig
```kconfig
# nRF52 DK nRF52810 board configuration

# Copyright (c) 2018 Nordic Semiconductor ASA
# SPDX-License-Identifier: Apache-2.0

if BOARD_SMARTWATCH

config BOARD
	default "smartWatch"

endif # BOARD_SMARTWATCH
```
